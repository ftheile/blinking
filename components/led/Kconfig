## components/led/Kconfig
```kconfig
menu "My LED configuration"
    config LED_DYNAMIC_INSTANCE
        bool "Enable dynamic LED creation/destruction"
        default y
        help
            This enables the dynamic creation/destruction of the LED component.

    config LED_PULL_CURRENT
        bool "GPIO pulls current through the LED"
        default y
        help
            Enable:  GPIO pulls LED current.
            Disable: GPIO pushes LED current.

endmenu  # My LED configuration
```
